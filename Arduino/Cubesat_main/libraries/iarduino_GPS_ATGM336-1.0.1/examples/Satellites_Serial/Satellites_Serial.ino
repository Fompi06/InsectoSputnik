// ПРИМЕР ВЫВОДИТ ДАННЫЕ О СПУТНИКАХ:              //
                                                   //
#include <iarduino_GPS_NMEA.h>                     //  Подключаем библиотеку для расшифровки строк протокола NMEA получаемых по UART.
#include <iarduino_GPS_ATGM336.h>                  //  Подключаем библиотеку для настройки параметров работы GPS модуля ATGM336.
                                                   //
iarduino_GPS_NMEA    gps;                          //  Объявляем объект gps         для работы с функциями и методами библиотеки iarduino_GPS_NMEA.
iarduino_GPS_ATGM336 SettingsGPS;                  //  Объявляем объект SettingsGPS для работы с функциями и методами библиотеки iarduino_GPS_ATGM336.
                                                   //
uint8_t i[30][7];                                  //  Объявляем массив для получения данных о 30 спутниках в формате: {ID спутника (1...255), Отношение сигнал/шум (SNR) в дБ, тип навигационной системы (1-GPS/2-Глонасс/3-Galileo/4-Beidou/5-QZSS), Флаг участия спутника в позиционировании (1/0), Угол возвышения спутника (0°-горизонт ... 90°-зенит), Азимут положения спутника (0°...255°), Остаток азимута до 360° }.
char* sa[]={"NoName ","GPS    ","Глонасс"};        //  Определяем массив строк содержащих названия навигационных систем спутников.
                                                   //
void setup(){                                      //
//   Инициируем работу библиотек:                  //
     Serial.begin(9600);                           //  Инициируем работу с аппаратной шиной UART для вывода данных в монитор последовательного порта на скорости 9600 бит/сек.
     SettingsGPS.begin(Serial1);                   //  Инициируем работу с GPS модулем по указанной шине UART. Функция сама определит текущую скорость GPS модуля ATGM336 (вместо аппаратной шины, можно указывать программную).
     gps.begin(Serial1);                           //  Инициируем расшифровку строк NMEA указав объект используемой шины UART (вместо аппаратной шины, можно указывать программную).
//   Настраиваем работу модуля:                    //
     SettingsGPS.baudrate(9600);                   //  Устанавливаем скорость передачи данных модулем и скорость работы шины UART в 9600 бит/сек.
     SettingsGPS.system(GPS_GP, GPS_GL);           //  Указываем что данные нужно получать от спутников навигационных систем GPS (GPS_GP) и Glonass (GPS_GL).
     SettingsGPS.composition(NMEA_GSA, NMEA_GSV);  //  Указываем что каждый пакет данных NMEA должен содержать только строки идентификаторов GSA (информация об активных спутниках) и GSV (информация о наблюдаемых спутниках).
     SettingsGPS.updaterate(2);                    //  Указываем обновлять данные 2 раза в секунду. Функция gps.read() читает данные в 2 раза медленнее чем их выводит модуль.
}                                                  //
                                                   //
void loop(){                                       //
     gps.read(i);                                  //  Читаем данные с получением информации о спутниках в массив i (чтение может занимать больше 1 секунды). Если указать второй параметр gps.read(i,true); то в массиве окажутся данные только тех спутников, которые принимают участие в позиционировании.
     for(uint8_t j=0; j<30; j++){                  //  Проходим по всем элементам массива «i».
        if( i[j][0] ){                             //  Если у спутника есть ID, то выводим информацию о нём:
            if(j<9) Serial.print(0);               //  Выводим ведущий 0.
            Serial.print(j+1);                     //  Выводим номер строки в мониторе последовательного порта.
            Serial.print(") Спутник ");            //
            Serial.print(sa[i[j][2]]);             //  Выводим название навигационной системы спутника.
            Serial.print(" ID: ");                 //
            if(i[j][0]<10) Serial.print(0);        //  Выводим ведущий 0.
            Serial.print(i[j][0]);                 //  Выводим ID спутника.
            Serial.print(". Уровень: ");           //
            if(i[j][1]<10) Serial.print(0);        //  Выводим ведущий 0.
            Serial.print(i[j][1]);                 //  Выводим отношение сигнал/шум (SNR) в дБ.
            Serial.print("дБ. Возвышение: ");      //
            if(i[j][4]<10) Serial.print(0);        //  Выводим ведущий 0.
            Serial.print(i[j][4]);                 //  Выводим возвышение спутника относительно модуля (0°-горизонт ... 90°-зенит).
            Serial.print("°. Азимут: ");           //
            if(i[j][5]<100) Serial.print(0);       //  Выводим ведущий 0.
            if(i[j][5]<10) Serial.print(0);        //  Выводим ведущий 0.
            Serial.print(i[j][5]+i[j][6]);         //  Выводим азимут нахождения спутника относительно модуля (0...360°).
            Serial.print("°. ");                   //
            if(i[j][3]){Serial.print("Участвует в позиционировании.");}
            Serial.print("\r\n");                  //
        }                                          //
    }                                              //
    Serial.println("---------------------------"); //
}                                                  //
                                                   //
//   ПРИМЕЧАНИЕ:                                   //  ВАЖНО:
//   В скетче определён состав пакета NMEA         //  Уменьшение идентификаторов в составе пакета NMEA приводит
//   обращением к функции composition();           //  к уменьшению количества данных содержащихся в нём.
//   Но выбранные в данном скетче идентификаторы   //  
//   NMEA_GSA и NMEA_GSV содержат только данные    //  Рекомендуется использовать следующий состав пакета NMEA:
//   о спутниках и не содержат другой информации.  //  SettingsGPS.composition(NMEA_RMC); - все данные, кроме высоты и данных о спутниках.
//   Значит если не переопределить состав пакета,  //  SettingsGPS.composition(NMEA_RMC, NMEA_GGA); - все данные кроме данных о спутниках.
//   данные о дате, времени, координатах и т.д.,   //  SettingsGPS.composition(NMEA_RMC, NMEA_GGA, NMEA_GSA, NMEA_GSV); - все данные.
//   будут недоступны.                             //  